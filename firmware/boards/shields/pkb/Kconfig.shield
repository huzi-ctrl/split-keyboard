## firmware/boards/shields/pkb/Kconfig.shield
```kconfig
config SHIELD_PKB_LEFT
    def_bool $(shields_list_contains,pkb_left)

config SHIELD_PKB_RIGHT
    def_bool $(shields_list_contains,pkb_right)
```
